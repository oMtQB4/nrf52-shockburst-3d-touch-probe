## boards/arm/shockburst_probe/Kconfig.board
```kconfig
# Copyright (c) 2022 Nordic Semiconductor ASA
# SPDX-License-Identifier: Apache-2.0

config BOARD_SHOCKBURST_PROBE
	bool "ShockBurst_Probe"
	depends on SOC_NRF52810_QFAA
```

## boards/arm/shockburst_probe/Kconfig.defconfig
```kconfig
# Copyright (c) 2022 Nordic Semiconductor ASA
# SPDX-License-Identifier: Apache-2.0

if BOARD_SHOCKBURST_PROBE

config BOARD
	default "shockburst_probe"

endif
```
